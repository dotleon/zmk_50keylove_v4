## boards/shields/50keylove_v4/Kconfig.defconfig
```kconfig
if SHIELD_50KEYLOVE_V4

# Name must be less than 16 characters long!
config ZMK_KEYBOARD_NAME
    default "50keylove v4"

endif
```

## boards/shields/50keylove_v4/Kconfig.shield
```kconfig
config SHIELD_50KEYLOVE_V4
    def_bool $(shields_list_contains,50keylove_v4)

config SHIELD_50KEYLOVE_V4_DONGLE
    def_bool $(shields_list_contains,50keylove_v4_dongle)
```

## boards/shields/50keylove_v4_dongle/Kconfig.shield
```kconfig
config SHIELD_50KEYLOVE_V4_DONGLE
    def_bool $(shields_list_contains,50keylove_v4_dongle)
```
